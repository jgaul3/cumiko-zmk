## boards/shields/cumiko/Kconfig.defconfig
```kconfig
if SHIELD_CUMIKO_LEFT

config ZMK_KEYBOARD_NAME
	default "Cumiko"

config ZMK_SPLIT_ROLE_CENTRAL
	default y

endif

if SHIELD_CUMIKO_LEFT || SHIELD_CUMIKO_RIGHT

config ZMK_SPLIT
	default y
	
endif
```

## boards/shields/cumiko/Kconfig.shield
```kconfig
config SHIELD_CUMIKO_LEFT
	def_bool $(shields_list_contains,cumiko_left)

config SHIELD_CUMIKO_RIGHT
	def_bool $(shields_list_contains,cumiko_right)
```
